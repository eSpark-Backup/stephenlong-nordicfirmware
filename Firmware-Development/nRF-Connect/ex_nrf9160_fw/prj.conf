## CMakeLists.txt
```
#
# Copyright (c) 2020 Nordic Semiconductor
#
# SPDX-License-Identifier: LicenseRef-Nordic-5-Clause
#

cmake_minimum_required(VERSION 3.20.0)

find_package(Zephyr REQUIRED HINTS $ENV{ZEPHYR_BASE})
project(ex_nrf9160_fw)

# NORDIC SDK APP START
target_sources(app PRIVATE src/main.c src/lte.c src/dfu.c src/aws.c src/datetime.c src/json_support.c src/gps.c src/comm.c)
# NORDIC SDK APP END

zephyr_include_directories(src)
```

## sample.yaml
```
sample:
  name: AWS IoT sample
tests:
  samples.nrf9160.ex_nrf9160_fw:
    build_only: true
    platform_allow: nrf9160dk_nrf9160_ns thingy91_nrf9160_ns
    integration_platforms:
      - nrf9160dk_nrf9160_ns
      - thingy91_nrf9160_ns
    tags: ci_build
```

## prj.conf
```kconfig
#
# Copyright (c) 2020 Nordic Semiconductor ASA
#
# SPDX-License-Identifier: LicenseRef-Nordic-5-Clause
#
# General config
CONFIG_NCS_SAMPLES_DEFAULTS=y
CONFIG_REBOOT=y
CONFIG_HW_ID_LIBRARY=y
CONFIG_HW_ID_LIBRARY_SOURCE_IMEI=y

# NEWLIB C
CONFIG_NEWLIB_LIBC=y
CONFIG_NEWLIB_LIBC_FLOAT_PRINTF=y

# Network
CONFIG_NETWORKING=y
CONFIG_NET_NATIVE=n

# LTE link control
CONFIG_LTE_LINK_CONTROL=y
CONFIG_LTE_NETWORK_MODE_NBIOT_GPS=y


# Modem library
CONFIG_NRF_MODEM_LIB=y

# AT Host
CONFIG_UART_INTERRUPT_DRIVEN=y
CONFIG_AT_HOST_LIBRARY=y

# AWS IoT library
CONFIG_AWS_IOT=y
CONFIG_AWS_IOT_BROKER_HOST_NAME="a31lp8au9sf1l1-ats.iot.us-west-1.amazonaws.com"
CONFIG_AWS_IOT_TOPIC_UPDATE_DELTA_SUBSCRIBE=n
CONFIG_AWS_IOT_TOPIC_GET_ACCEPTED_SUBSCRIBE=n
CONFIG_AWS_IOT_TOPIC_GET_REJECTED_SUBSCRIBE=n

# MQTT helper library
CONFIG_MQTT_HELPER=y
CONFIG_MQTT_HELPER_SEC_TAG=123456789
CONFIG_MQTT_HELPER_LAST_WILL=y
CONFIG_MQTT_HELPER_STACK_SIZE=4096

# MQTT - Maximum MQTT keepalive timeout specified by AWS IoT Core
CONFIG_MQTT_KEEPALIVE=1200
CONFIG_MQTT_CLEAN_SESSION=y
CONFIG_AWS_IOT_CONNECT_TIMEOUT_SECONDS=60

# Date Time library
CONFIG_DATE_TIME=y

# Modem information
CONFIG_MODEM_INFO=y

# Heap and stacks
CONFIG_HEAP_MEM_POOL_SIZE=8192
CONFIG_MAIN_STACK_SIZE=8192
CONFIG_SYSTEM_WORKQUEUE_STACK_SIZE=4096

# MCUBOOT
CONFIG_BOOTLOADER_MCUBOOT=y
CONFIG_MCUBOOT_IMG_MANAGER=y

# Image manager
CONFIG_IMG_MANAGER=y
CONFIG_STREAM_FLASH=y
CONFIG_FLASH_MAP=y
CONFIG_FLASH=y
CONFIG_IMG_ERASE_PROGRESSIVELY=y

# AWS FOTA
CONFIG_AWS_FOTA=y
CONFIG_FOTA_DOWNLOAD=y
CONFIG_DFU_TARGET=y

# CJSON
CONFIG_CJSON_LIB=y

# Download client (needed by AWS FOTA)
CONFIG_DOWNLOAD_CLIENT=y
CONFIG_DOWNLOAD_CLIENT_STACK_SIZE=4096

# LTE link control
CONFIG_LTE_PSM_REQ=y
## Power saving timers.
### 320 hours PSM.
CONFIG_LTE_PSM_REQ_RPTAU="11000001"
### 20 seconds active time.
CONFIG_LTE_PSM_REQ_RAT="00001010"

CONFIG_PUBLICATION_INTERVAL_SECONDS=300

# Enable Floating Point
CONFIG_FPU=y

# Enable eDRX and PSM
CONFIG_LTE_LC_EDRX_MODULE=y
CONFIG_LTE_LC_PSM_MODULE=y

CONFIG_SERIAL=y
CONFIG_UART_INTERRUPT_DRIVEN=y

# Logging
CONFIG_LOG=y
CONFIG_USE_SEGGER_RTT=y
CONFIG_LOG_BACKEND_RTT=y
CONFIG_LOG_BACKEND_UART=n
CONFIG_LOG_DEFAULT_LEVEL=3
```

## src/main.c
```c
/*
 * Copyright (c) 2020 Nordic Semiconductor ASA
 *
 * SPDX-License-Identifier: LicenseRef-Nordic-5-Clause
 */

#include <zephyr/kernel.h>
#include <zephyr/sys/printk.h>
#include <stdio.h>
#include <stdlib.h>
#include <math.h>
#include <nrf_modem_gnss.h>
#if defined(CONFIG_NRF_MODEM_LIB)
#include <modem/lte_lc.h>
#include <modem/nrf_modem_lib.h>
#include <modem/modem_info.h>
#include <nrf_modem.h>
#endif
#include <net/aws_iot.h>
#include <zephyr/sys/reboot.h>
#include <date_time.h>
#include <zephyr/dfu/mcuboot.h>
#include <cJSON.h>
#include <cJSON_os.h>
#include <hw_id.h>

#include "json_support.h"
#include "datetime.h"
#include "lte.h"
#include "dfu.h"
#include "gps.h"
#include "aws.h"
#include "comm.h"
#include "main.h"

#define DEBUG_ON
#define SEND_LAST_VALID_FIX_TO_CLOUD
#define DEFAULT_GPS_FIX_INTERVAL 120
#define DEFAULT_AWS_INTERVAL 300

BUILD_ASSERT(!IS_ENABLED(CONFIG_LTE_AUTO_INIT_AND_CONNECT),
		"This sample does not support LTE auto-init and connect");

struct k_work_delayable shadow_update_work;
struct k_work_delayable connect_work;
struct k_work shadow_update_version_work;
struct k_work_delayable gnss_start_single_fix;
struct k_work_delayable gnss_work;

bool cloud_connected;
bool gps_fix_valid = false;
int gps_interval = DEFAULT_GPS_FIX_INTERVAL;
int aws_interval = DEFAULT_AWS_INTERVAL;
double last_reported_latitude;
double last_reported_longitude;
float last_reported_voltage = NAN, last_reported_temperature = NAN, last_reported_humidity = NAN;
static bool gnss_is_running = false;
static int gnss_not_enough_window_time_cnt = 0;
static int last_set_gps_interval = DEFAULT_GPS_FIX_INTERVAL;

static char hw_id[HW_ID_LEN];

void pvtflagsstatus(){
	if (pvt_data.flags & NRF_MODEM_GNSS_PVT_FLAG_DEADLINE_MISSED) {
		printk("GNSS blocked by LTE activity\n");
	}
	if (pvt_data.flags & NRF_MODEM_GNSS_PVT_FLAG_LEAP_SECOND_VALID) {
		printk("The leap second information is valid\n");
	}
	if (pvt_data.flags & NRF_MODEM_GNSS_PVT_FLAG_SLEEP_BETWEEN_PVT) {
		printk("At least one sleep period has passed since the last PVT notification\n");
	}
	if (pvt_data.flags & NRF_MODEM_GNSS_PVT_FLAG_VELOCITY_VALID) {
		printk("The velocity estimate is valid\n");
	} 
	if (pvt_data.flags & NRF_MODEM_GNSS_PVT_FLAG_SCHED_DOWNLOAD) {
		printk("The PVT notification was sent because of a scheduled download\n");
	}
}

int main(void)
{
	int err;

	printk("The AWS IoT sample started, version: %s\n", CONFIG_APP_VERSION);

	cJSON_Init();

	// This example supports Amazon Web Services firmware over-the-air (AWS FOTA)
	// Update. Check update status, if FW update has just occured.
	nrf_modem_lib_dfu_handler();

	// This thread must be initialized before gnss_init() as this func schedules it
	k_work_init_delayable(&gnss_start_single_fix, gnss_start_single_fix_fn);
	// Initialize GNSS in Single fix mode
	gnss_init();

	// Initialise modem information module. Used to request battery voltage data
	// from the modem
	err = modem_info_init();
	if (err) {
		printk("Failed initializing modem info module, error: %d\n", err);
	}

	// Obtain the modems' IMEI (International Mobile Equipment Identity). We use
	// this as the client ID (thing ID) when communicating with the AWS IoT Broker
	err = hw_id_get(hw_id, ARRAY_SIZE(hw_id));
	if (err) {
		printk("Failed to retrieve hardware ID, error: %d", err);
		return err;
	}

	printk("IMEI: %s\n", hw_id);

	// The AWS IOT Client ID should match the 'Thing Name' on the 
	// AWS IoT console. It can be set in the prj.conf using: 
	// CONFIG_AWS_IOT_CLIENT_ID_STATIC="<Thing Name>" 
	// or at run time using the aws_iot_config structure passed 
	// to aws_iot_connect(); If using this option, set 
	// CONFIG_AWS_IOT_CLIENT_ID_APP=y
	
	// Setting the Client ID at runtime allows the developer to 
	// easly deploy fleets of devices with the same firmware. 
	// In this case we read the modem's IMEI and use this as
	// the Client ID.

	// Initialise Amazon Web Services IoT Module
	err = aws_iot_init(aws_iot_event_handler);
	if (err) {
		printk("AWS IoT library could not be initialized, error: %d\n", err);
	}

	// Subscribe to customizable non-shadow specific topics.
	// Topics will be subscribed to upon connection to AWS IoT broker.
	err = app_topics_subscribe();
	if (err) {
		printk("Adding application specific topics failed, error: %d\n", err);
	}

	// Initialise Workqueue Threads 
	// Thread connect_work is responsible for connecting and reconnecting to the 
	// AWS IoT broker.
	k_work_init_delayable(&connect_work, connect_work_fn);
	// Thread shadow_update_version_work only publishes a message (with version 
	// number) upon an initial connection. 
	k_work_init(&shadow_update_version_work, shadow_update_version_work_fn);
	// Thread shadow_update_work continues to periodically publish a message 
	// (without version number)
	k_work_init_delayable(&shadow_update_work, shadow_update_work_fn);
	// Thread gnss_start_single_fix periodically takes a single fix mode gps fix, it must be initialized before gnss_init() as the func schedules it
	// k_work_init_delayable(&gnss_start_single_fix, gnss_start_single_fix_fn);
	// Thread gnss_work checks for valid gps fixes and processes it
	k_work_init_delayable(&gnss_work, gnss_work_fn);
		
	// Initialise LTE modem and LTE handler callback
	modem_configure();

	// Wait for LTE modem to connect 
	k_sem_take(&lte_connected, K_FOREVER);

	// Update date & time
	date_time_update_async(date_time_event_handler);

	// Initiate connection to AWS IoT MQTT 
	k_work_schedule(&connect_work, K_NO_WAIT);

    comm_init();
}

void connect_work_fn(struct k_work *work)
{
	int err;

	if (cloud_connected) {
		return;
	}

	const struct aws_iot_config config = {
		.client_id = hw_id,
	};

	// Connect to AWS IoT broker (MQTT)
	err = aws_iot_connect(&config);
	if (err) {
		printk("aws_iot_connect, error: %d\n", err);
		if(err == -EOPNOTSUPP || err == -ENOTCONN){

		}
	}

	printk("Next connection retry in %d seconds\n", CONFIG_CONNECTION_RETRY_TIMEOUT_SECONDS);

	k_work_schedule(&connect_work, K_SECONDS(CONFIG_CONNECTION_RETRY_TIMEOUT_SECONDS));
}

void shadow_update_work_fn(struct k_work *work)
{
	int err;

	if (!cloud_connected) {
		return;
	}

	// Update shadow with-out version number (Type 1)
	err = shadow_update(false);
	if (err) {
		printk("shadow_update, error: %d\n", err);
	}

#ifdef SEND_LAST_VALID_FIX_TO_CLOUD
	gps_fix_valid = false;
#endif

	printk("Next data publication in %d seconds\n", aws_interval);

	k_work_schedule(&shadow_update_work, K_SECONDS(aws_interval));
}

void shadow_update_version_work_fn(struct k_work *work)
{
	int err;

	// Update shadow with version number (Type 2)
	err = shadow_update(true);
	if (err) {
		printk("shadow_update, error: %d\n", err);
	}
}

void gnss_start_single_fix_fn(struct k_work *work)
{
	int err;
#ifndef SEND_LAST_VALID_FIX_TO_CLOUD
	gps_fix_valid = false;
#endif

	// Stop GNSS if it is already running
	if (gnss_is_running) {
		printk("Stopping GNSS\n");
		err = nrf_modem_gnss_stop();
		if (err) {
			printk("Failed to stop GNSS, error %d\n", err);
			return; // Exit early on failure to avoid conflicts
		}
		gnss_is_running = false; // GNSS is now stopped
	}

	// Reconfigure GNSS
	if(gps_interval != last_set_gps_interval){
		last_set_gps_interval = gps_interval;
		printk("Reconfiguring GNSS Fix Retry Interval\n");
		err = nrf_modem_gnss_fix_retry_set(gps_interval - 10);
		if (err) {
			printk("Error during GNSS re-configuration: %d\n", err);
			return; // Exit early on failure
		}
	}
	
	// Start GNSS
	printk("Starting GNSS\n");
    err = nrf_modem_gnss_start();
    if (err) {
        printk("Failed to start GNSS, error %d\n", err);
        return; // Exit early on failure
    }
	gnss_is_running = true;

	// //Must be called when GNSS is running
	// printk("Enabling Priority\n");
	// err = nrf_modem_gnss_prio_mode_enable();
	// if (err) {
	// 	printk("Could not set priority mode for GNSS (%d)", err);
	// }

	printk("Next fix to be taken in %d seconds\n", gps_interval);
	k_work_schedule(&gnss_start_single_fix, K_SECONDS(gps_interval));
}

void gnss_work_fn(){

#ifdef DEBUG_ON
	pvtflagsstatus();
#endif

	if (pvt_data.flags & NRF_MODEM_GNSS_PVT_FLAG_NOT_ENOUGH_WINDOW_TIME) {
		printk("Average time windows granted to GNSS may be too short\n");
		//GNSS priority may interfere with LTE operations, In general, long enough
		//eDRX cycles, or PSM, will ensure better functionality for both GNSS and LTE.
		//Mess with priority only when PSM is refused by network provider
		if (psm_activated == false){
			gnss_not_enough_window_time_cnt++;
			if (gnss_not_enough_window_time_cnt == 3){
				//Must be called when GNSS is running
				printk("Enabling GNSS Priority Over RCC IDLE\n");
				if (nrf_modem_gnss_prio_mode_enable()) {
					printk("Could not set priority mode for GNSS");
				}
				gnss_not_enough_window_time_cnt = 0;
			}
		}
	}

	if (pvt_data.flags & NRF_MODEM_GNSS_PVT_FLAG_FIX_VALID) {
		printk("Latitude: %.06f Longitude: %.06f\n", pvt_data.latitude, pvt_data.longitude);
		last_reported_latitude = pvt_data.latitude;
		last_reported_longitude = pvt_data.longitude;
		gps_fix_valid = true;
	}
	else {
		int found = 0;
		//int fix = 0;
		for (int i = 0; i < NRF_MODEM_GNSS_MAX_SATELLITES; ++i) {
			if (pvt_data.sv[i].sv > 0) {
				found++;
				//Print satelite number:
				//printf("SV Number %d ", pvt_data.sv[i].sv);

				//Flag is only set once we have a fix, and at that
				//stage, this routine is no longer called.
				//if (pvt_data.sv[i].flags & NRF_MODEM_GNSS_SV_FLAG_USED_IN_FIX) fix++;
			}
		}
		printk("Searching: Found %d SV\n",found);
	}
}
```

## src/aws.c
```c
#include <zephyr/kernel.h>
#include <stdio.h>
#include <stdlib.h>
#include <math.h>
#include <net/aws_iot.h>
#include <modem/lte_lc.h>
#include <modem/nrf_modem_lib.h>
#include <nrf_modem_gnss.h>
#include <modem/modem_info.h>
#include <nrf_modem.h>
#include <cJSON.h>
#include <cJSON_os.h>
#include <zephyr/sys/reboot.h>
#include <zephyr/dfu/mcuboot.h>
#include <date_time.h>
#include "json_support.h"
#include "aws.h"
#include "gps.h"
#include "main.h"

//#define PSM_ENABLED

#define AWS_IOT_PUB_CUSTOM_TOPIC "my-custom-topic/status"
#define AWS_IOT_SUB_CUSTOM_TOPIC "my-custom-topic/set"

#define MY_CUSTOM_TOPIC_1  "my-custom-topic/example"
#define MY_CUSTOM_TOPIC_2  "my-custom-topic/example2"

void add_sensor_data_to_report(cJSON *reported_obj)
{
    if (!isnan(last_reported_temperature))
    {
        json_add_number(reported_obj, "temperature", last_reported_temperature);
    }

    if (!isnan(last_reported_humidity))
    {
        json_add_number(reported_obj, "humidity", last_reported_humidity);
    }

    if (!isnan(last_reported_voltage))
    {
        json_add_number(reported_obj, "voltage", last_reported_voltage);
    }
}

int app_topics_subscribe(void)
{
	int err;

	// By default, connection made to AWS IoT Broker is using a persistent 
	// session. This means the broker will store subscriptions. Any topic name 
	// modifications may not become active until the persistant connection 
	// session expiration time elapses.
	// https://docs.aws.amazon.com/iot/latest/developerguide/mqtt.html#mqtt-persistent-sessions

	// If modifing topic names, you may wish to temporary add the following
	// to your prj.conf to create a clean session on each connection.
	// CONFIG_MQTT_CLEAN_SESSION=y
		
	// If persistance sessions are enabled, on the nRF9160 console you should
	// see the following statement after aws_iot_connect() is called.
	//  AWS_IOT_EVT_CONNECTED
	// *Persistent session enabled

	static const struct mqtt_topic topic_list[] = {
		{
			.topic.utf8 = MY_CUSTOM_TOPIC_1,
			.topic.size = strlen(MY_CUSTOM_TOPIC_1),
			.qos = MQTT_QOS_1_AT_LEAST_ONCE,
		},
		{
			.topic.utf8 = MY_CUSTOM_TOPIC_2,
			.topic.size = strlen(MY_CUSTOM_TOPIC_2),
			.qos = MQTT_QOS_1_AT_LEAST_ONCE,
		}
	};

	err = aws_iot_application_topics_set(topic_list, ARRAY_SIZE(topic_list));
	if (err) {
		printk("aws_iot_subscription_topics_add, error: %d\n", err);
	}

	return err;
}

int shadow_update(bool version_number_include)
{
	int err;
	char *message;
	int64_t message_ts = 0;
	int16_t bat_voltage = 0;

	err = date_time_now(&message_ts);
	if (err) {
		printk("date_time_now, error: %d\n", err);
		return err;
	}

#if defined(CONFIG_NRF_MODEM_LIB)
	/* Request battery voltage data from the modem. */
	err = modem_info_short_get(MODEM_INFO_BATTERY, &bat_voltage);
	if (err != sizeof(bat_voltage)) {
		printk("modem_info_short_get, error: %d\n", err);
		return err;
	}
#endif

	cJSON *root_obj = cJSON_CreateObject();
	cJSON *state_obj = cJSON_CreateObject();
	cJSON *reported_obj = cJSON_CreateObject();

	if (root_obj == NULL || state_obj == NULL || reported_obj == NULL) {
		cJSON_Delete(root_obj);
		cJSON_Delete(state_obj);
		cJSON_Delete(reported_obj);
		err = -ENOMEM;
		return err;
	}

	if (version_number_include) {
		err = json_add_str(reported_obj, "app_version",
				    CONFIG_APP_VERSION);
	} else {
		err = 0;
	}

	if (gps_fix_valid) {
		err += json_add_number(reported_obj, "latitude", last_reported_latitude);
		err += json_add_number(reported_obj, "longitude", last_reported_longitude);
	}
	
    add_sensor_data_to_report(reported_obj);

	err += json_add_number(reported_obj, "batv", bat_voltage);
	err += json_add_number(reported_obj, "ts", message_ts);
	err += json_add_obj(state_obj, "reported", reported_obj);
	err += json_add_obj(root_obj, "state", state_obj);

	if (err) {
		printk("json_add, error: %d\n", err);
		goto cleanup;
	}

	message = cJSON_Print(root_obj);
	if (message == NULL) {
		printk("cJSON_Print, error: returned NULL\n");
		err = -ENOMEM;
		goto cleanup;
	}

	struct aws_iot_data tx_data = {
		.qos = MQTT_QOS_0_AT_MOST_ONCE,
		.topic.type = AWS_IOT_SHADOW_TOPIC_UPDATE,
		.ptr = message,
		.len = strlen(message)
	};

	printk("Publishing: %s to AWS IoT broker\n", message);

	err = aws_iot_send(&tx_data);
	if (err) {
		printk("aws_iot_send, error: %d\n", err);
	}

	cJSON_FreeString(message);

cleanup:

	cJSON_Delete(root_obj);

	return err;
}

int publish_custom_topic(void)
{
	int err;
	char *message;

	cJSON *root_obj = cJSON_CreateObject();

	if (root_obj == NULL) {
		cJSON_Delete(root_obj);
		err = -ENOMEM;
		return err;
	}

	err = json_add_number(root_obj, "Test", 1);
	
	if (err) {
		printk("json_add, error: %d\n", err);
		goto cleanup;
	}

	message = cJSON_Print(root_obj);
	if (message == NULL) {
		printk("cJSON_Print, error: returned NULL\n");
		err = -ENOMEM;
		goto cleanup;
	}

	struct aws_iot_data tx_data = {
		.qos = MQTT_QOS_0_AT_MOST_ONCE,
		.topic.str = AWS_IOT_PUB_CUSTOM_TOPIC,
		.topic.len = strlen(AWS_IOT_PUB_CUSTOM_TOPIC),
		.ptr = message,
		.len = strlen(message)
	};

	printk("Publishing: %s to AWS IoT broker\n", message);

	err = aws_iot_send(&tx_data);
	if (err) {
		printk("aws_iot_send, error: %d\n", err);
	}

	cJSON_FreeString(message);

cleanup:

	cJSON_Delete(root_obj);

	return err;
}

void print_received_data(const char *buf, const char *topic, size_t topic_len)
{
	char *str = NULL;
	cJSON *root_obj = NULL;

	root_obj = cJSON_Parse(buf);
	if (root_obj == NULL) {
		printk("cJSON Parse failure");
		return;
	}

	str = cJSON_Print(root_obj);
	if (str == NULL) {
		printk("Failed to print JSON object");
		goto clean_exit;
	}

	printf("Data received from AWS IoT console:\nTopic: %.*s\nMessage: %s\n",
		topic_len, topic, str);

	cJSON_FreeString(str);

clean_exit:
	cJSON_Delete(root_obj);
}

void process_received_data(const char *buf, const char *topic, size_t topic_len)
{
	// topic may not be null terminated, so need to use topic_len;
	// if(strncmp(topic, AWS_IOT_SUB_CUSTOM_TOPIC, topic_len) == 0) {
	// 	//printk("Found AWS_IOT_SUB_CUSTOM_TOPIC\n");
	// 	process_custom_topic(buf, topic, topic_len);
	// }
	if(strncmp(topic, MY_CUSTOM_TOPIC_1, topic_len) == 0) {
		//printk("Found MY_CUSTOM_TOPIC_1\n");
		process_custom_topic(buf, topic, topic_len);
	}
}

void process_custom_topic(const char *buf, const char *topic, size_t topic_len)
{
	// // Parses a payload with the following format:
	// // {
	// //		"reset": 1
	// // }

	// cJSON *root_obj = NULL;
	// int reset;

	// root_obj = cJSON_Parse(buf);
	// if (root_obj == NULL) {
	// 	printk("cJSON Parse failure");
	// 	return;
	// }

	// if (cJSON_HasObjectItem(root_obj, "reset")) {
	// 	cJSON *item = NULL;
	// 	item = cJSON_GetObjectItem(root_obj, "reset");
	// 	reset = cJSON_GetNumberValue(item);
	// 	printk("Reset = %d\n",reset);
	// }

	// cJSON_Delete(root_obj);

	cJSON *root_obj = NULL;

	root_obj = cJSON_Parse(buf);
	if (root_obj == NULL) {
		printk("cJSON Parse failure");
		return;
	}

	cJSON *gps_interval_item = cJSON_GetObjectItemCaseSensitive(root_obj, "gps_interval");
    cJSON *aws_interval_item = cJSON_GetObjectItemCaseSensitive(root_obj, "aws_interval");

	if (!cJSON_IsNumber(gps_interval_item) || !cJSON_IsNumber(aws_interval_item))
	{
		goto clean_exit;
	}

	printf("New GPS Interval: %d\n", gps_interval_item->valueint);
	printf("New AWS Interval: %d\n", aws_interval_item->valueint);

	//Update intervals sent from cloud
	if (gps_interval_item->valueint >= 20){
		gps_interval = gps_interval_item->valueint;
	}
	else{
		printf("Wrong GPS interval chosen: %d, reusing: %d\n", gps_interval_item->valueint, gps_interval);
	}
	aws_interval = aws_interval_item->valueint;

clean_exit:
	cJSON_Delete(root_obj);

}

void aws_iot_event_handler(const struct aws_iot_evt *const evt)
{
	int err;

	switch (evt->type) {
		case AWS_IOT_EVT_CONNECTING:
			printk("AWS_IOT_EVT_CONNECTING\n");
			break;

		case AWS_IOT_EVT_CONNECTED:
			printk("AWS_IOT_EVT_CONNECTED\n");

			cloud_connected = true;
			/* This may fail if the work item is already being processed,
			* but in such case, the next time the work handler is executed,
			* it will exit after checking the above flag and the work will
			* not be scheduled again.
			*/
			(void)k_work_cancel_delayable(&connect_work);

			if (evt->data.persistent_session) {
				printk("Persistent session enabled\n");
			}

	#if defined(CONFIG_NRF_MODEM_LIB)
			/** Successfully connected to AWS IoT broker, mark image as
			 *  working to avoid reverting to the former image upon reboot.
			 */
			boot_write_img_confirmed();
	#endif

			/** Send version number to AWS IoT broker to verify that the
			 *  FOTA update worked.
			 */
			k_work_submit(&shadow_update_version_work);

			/** Start sequential shadow data updates.
			 */
			k_work_schedule(&shadow_update_work, K_SECONDS(aws_interval));

#ifdef PSM_ENABLED
			err = lte_lc_psm_req(true);
			if (err) {
				printk("Requesting PSM failed, error: %d\n", err);
			}
#endif
			break;

		case AWS_IOT_EVT_DISCONNECTED:
			printk("AWS_IOT_EVT_DISCONNECTED\n");
			cloud_connected = false;
			/* This may fail if the work item is already being processed,
			* but in such case, the next time the work handler is executed,
			* it will exit after checking the above flag and the work will
			* not be scheduled again.
			*/
			(void)k_work_cancel_delayable(&shadow_update_work);
			k_work_schedule(&connect_work, K_NO_WAIT);
			break;

		case AWS_IOT_EVT_DATA_RECEIVED:
			printk("AWS_IOT_EVT_DATA_RECEIVED\n");
			print_received_data(evt->data.msg.ptr, evt->data.msg.topic.str,	evt->data.msg.topic.len);
			process_received_data(evt->data.msg.ptr, evt->data.msg.topic.str, evt->data.msg.topic.len);
			break;

		case AWS_IOT_EVT_FOTA_START:
			printk("AWS_IOT_EVT_FOTA_START\n");
			break;

		case AWS_IOT_EVT_FOTA_ERASE_PENDING:
			printk("AWS_IOT_EVT_FOTA_ERASE_PENDING\n");
			printk("Disconnect LTE link or reboot\n");
	#if defined(CONFIG_NRF_MODEM_LIB)
			err = lte_lc_offline();
			if (err) {
				printk("Error disconnecting from LTE\n");
			}
	#endif
			break;

		case AWS_IOT_EVT_FOTA_ERASE_DONE:
			printk("AWS_FOTA_EVT_ERASE_DONE\n");
			printk("Reconnecting the LTE link");
	#if defined(CONFIG_NRF_MODEM_LIB)
			err = lte_lc_connect();
			if (err) {
				printk("Error connecting to LTE\n");
			}
	#endif
			break;

		case AWS_IOT_EVT_FOTA_DONE:
			printk("AWS_IOT_EVT_FOTA_DONE\n");
			printk("FOTA done, rebooting device\n");
			aws_iot_disconnect();
			sys_reboot(0);
			break;

		case AWS_IOT_EVT_FOTA_DL_PROGRESS:
			printk("AWS_IOT_EVT_FOTA_DL_PROGRESS, (%d%%)",
				evt->data.fota_progress);

		case AWS_IOT_EVT_ERROR:
			printk("AWS_IOT_EVT_ERROR, %d\n", evt->data.err);
			break;

		case AWS_IOT_EVT_FOTA_ERROR:
			printk("AWS_IOT_EVT_FOTA_ERROR");
			break;

		default:
			printk("Unknown AWS IoT event type: %d\n", evt->type);
			break;
	}
}
```

## src/aws.h
```c
#pragma once

#define APP_TOPICS_COUNT CONFIG_AWS_IOT_APP_SUBSCRIPTION_LIST_COUNT

int app_topics_subscribe(void);
int shadow_update(bool version_number_include);
void aws_iot_event_handler(const struct aws_iot_evt *const evt);
int publish_custom_topic(void);
void print_received_data(const char *buf, const char *topic, size_t topic_len);
void process_received_data(const char *buf, const char *topic, size_t topic_len);
void process_custom_topic(const char *buf, const char *topic, size_t topic_len);
```

## src/certificates.h
```c
/*
 * Copyright (c) 2020 Nordic Semiconductor ASA
 *
 * SPDX-License-Identifier: LicenseRef-Nordic-5-Clause
 */
#pragma once

#define AWS_IOT_CLIENT_PRIVATE_KEY \
	"-----BEGIN RSA PRIVATE KEY-----\n" \
	"AWS_IOT_CLIENT_PRIVATE_KEY\n" \
	"-----END RSA PRIVATE KEY-----\n"

#define AWS_IOT_CLIENT_PUBLIC_CERTIFICATE \
	"-----BEGIN CERTIFICATE-----\n" \
	"AWS_IOT_CLIENT_PUBLIC_CERTIFICATE\n" \
	"-----END CERTIFICATE-----\n"

#define AWS_IOT_CA_CERTIFICATE \
	"-----BEGIN CERTIFICATE-----\n" \
	"AWS_IOT_CA_CERTIFICATE\n" \
	"-----END CERTIFICATE-----\n"
```

## src/comm.c
```c
/*
 * Copyright (c) 2022 Libre Solar Technologies GmbH
 *
 * SPDX-License-Identifier: Apache-2.0
 */

#include <zephyr/kernel.h>
#include <zephyr/device.h>
#include <zephyr/drivers/uart.h>
#include <zephyr/logging/log.h>
#include <cJSON.h>
#include <string.h>
#include "main.h"

LOG_MODULE_REGISTER(uart_logger, LOG_LEVEL_INF);

/* change this to any other UART peripheral if desired */
#define UART_DEVICE_NODE DT_CHOSEN(zephyr_shell_uart)

#define MSG_SIZE 128
#define UART_TIMEOUT_MS 1000

/* queue to store up to 10 messages (aligned to 4-byte boundary) */
K_MSGQ_DEFINE(uart_msgq, MSG_SIZE, 10, 4);

static const struct device *const uart_dev = DEVICE_DT_GET(UART_DEVICE_NODE);

/* receive buffer used in UART ISR callback */
static char rx_buf[MSG_SIZE];
static int rx_buf_pos;
static struct k_timer uart_timer;

void parse_and_update_values(const char *buf)
{
    cJSON *json = cJSON_Parse(buf);
    if (json == NULL)
    {
        LOG_ERR("Failed to parse JSON\n");
        return;
    }

    cJSON *temp = cJSON_GetObjectItem(json, "temperature");
    cJSON *hum = cJSON_GetObjectItem(json, "humidity");
    cJSON *volt = cJSON_GetObjectItem(json, "voltage");

    if (temp && cJSON_IsNumber(temp))
    {
        last_reported_temperature = (float)temp->valuedouble;
    }

    if (hum && cJSON_IsNumber(hum))
    {
        last_reported_humidity = (float)hum->valuedouble;
    }

    if (volt && cJSON_IsNumber(volt))
    {
        last_reported_voltage = (float)volt->valuedouble;
    }

    cJSON_Delete(json);
}

void send_buffer_to_queue(void)
{
    if (rx_buf_pos > 0)
    {
        rx_buf[rx_buf_pos] = '\0';
        parse_and_update_values(rx_buf);
        LOG_INF("Received message: %s", rx_buf);
        // k_msgq_put(&uart_msgq, &rx_buf, K_NO_WAIT);
        rx_buf_pos = 0;
    }
}

void uart_timeout_handler(struct k_timer *timer_id)
{
    send_buffer_to_queue();
}

void serial_cb(const struct device *dev, void *user_data)
{
    uint8_t c;

    if (!uart_irq_update(uart_dev))
    {
        return;
    }

    if (!uart_irq_rx_ready(uart_dev))
    {
        return;
    }

    while (uart_fifo_read(uart_dev, &c, 1) == 1)
    {
        if (rx_buf_pos < (sizeof(rx_buf) - 1))
        {
            rx_buf[rx_buf_pos++] = c;
            k_timer_start(&uart_timer, K_MSEC(UART_TIMEOUT_MS), K_NO_WAIT);
        }
        else
        {
            printk("RX buffer overflow, resetting\n");
            rx_buf_pos = 0;
        }
    }
}

void print_uart(char *buf)
{
    int msg_len = strlen(buf);
    for (int i = 0; i < msg_len; i++)
    {
        uart_poll_out(uart_dev, buf[i]);
    }
}

int comm_init(void)
{
    // char tx_buf[MSG_SIZE];

    if (!device_is_ready(uart_dev))
    {
        printk("UART device not found!\n");
        return 0;
    }

    int ret = uart_irq_callback_user_data_set(uart_dev, serial_cb, NULL);

    if (ret < 0)
    {
        printk("Error setting UART callback: %d\n", ret);
        return 0;
    }

    uart_irq_rx_enable(uart_dev);
    k_timer_init(&uart_timer, uart_timeout_handler, NULL);

    LOG_INF("nrf9160 Host Board Application Starting ");
    // while (k_msgq_get(&uart_msgq, &tx_buf, K_FOREVER) == 0)
    // {
    //     //     print_uart("Received : ");
    //     //     print_uart(tx_buf);
    //     //     print_uart("\r\n");
    //     LOG_INF("Received message: %s", tx_buf);
    // }
    return 0;
}
```

## src/comm.h
```c
#pragma once

int comm_init(void);
```

## src/datetime.h
```c
#pragma once

void date_time_event_handler(const struct date_time_evt *evt);
```

## src/dfu.c
```c
#include <zephyr/kernel.h>
#include <stdio.h>
#include <stdlib.h>
#if defined(CONFIG_NRF_MODEM_LIB)
#include <modem/lte_lc.h>
#include <modem/nrf_modem_lib.h>
#include <modem/modem_info.h>
#include <nrf_modem.h>
#endif
#include <zephyr/sys/reboot.h>
#include <zephyr/dfu/mcuboot.h>

void nrf_modem_lib_dfu_handler(void)
{
	int err;
	char buf[80];

	err = nrf_modem_lib_init();

	switch (err) {
		case NRF_MODEM_DFU_RESULT_OK:
			printk("Modem update suceeded, reboot\n");
			sys_reboot(SYS_REBOOT_COLD);
			break;

		case NRF_MODEM_DFU_RESULT_UUID_ERROR:
		case NRF_MODEM_DFU_RESULT_AUTH_ERROR:
			printk("Modem update failed, error: %d\n", err);
			printk("Modem will use old firmware\n");
			sys_reboot(SYS_REBOOT_COLD);
			break;

		case NRF_MODEM_DFU_RESULT_HARDWARE_ERROR:
		case NRF_MODEM_DFU_RESULT_INTERNAL_ERROR:
			printk("Modem update malfunction, error: %d, reboot\n", err);
			sys_reboot(SYS_REBOOT_COLD);
			break;
			
		default:
			break;
	}

	if ((err = modem_info_init())) {
		printk("MODEM: Failed initializing modem info module, error: %d\n", err);
	}

	if ((modem_info_string_get(MODEM_INFO_FW_VERSION, buf, 80) > 0)) {
		printk("Modem FW Ver: %s\n",buf);
	}

}
```

## src/dfu.h
```c
#pragma once

void nrf_modem_lib_dfu_handler(void);
```

## src/gps.c
```c
#include <zephyr/kernel.h>
#include <zephyr/sys/printk.h>
#include <modem/lte_lc.h>
#include <nrf_modem_gnss.h>
#include <modem/nrf_modem_lib.h>
#include <modem/modem_info.h>

#include "gps.h"
#include "main.h"

#define GNSS_FIX_RETRY_SEC 90

K_SEM_DEFINE(pvt_data_sem, 0, 1);

struct nrf_modem_gnss_pvt_data_frame pvt_data;

void gnss_event_handler(int event)
{
	switch (event) {
		
		case NRF_MODEM_GNSS_EVT_PVT:
			//printk("NRF_MODEM_GNSS_EVT_PVT:\n");
			if (nrf_modem_gnss_read(&pvt_data, sizeof(pvt_data), NRF_MODEM_GNSS_DATA_PVT) != 0) {
				printk("Error reading PVT data\n");
			} else {
				k_work_schedule(&gnss_work, K_NO_WAIT);
				//k_sem_give(&pvt_data_sem);
			}
			break;
		case NRF_MODEM_GNSS_EVT_FIX:
			printk("NRF_MODEM_GNSS_EVT_FIX:\n");
			break;
		case NRF_MODEM_GNSS_EVT_NMEA:
			printk("NRF_MODEM_GNSS_EVT_NMEA:\n");
			break;
		case NRF_MODEM_GNSS_EVT_AGNSS_REQ:
			printk("NRF_MODEM_GNSS_EVT_AGNSS_REQ:\n");
			break;
		case NRF_MODEM_GNSS_EVT_BLOCKED:
			printk("NRF_MODEM_GNSS_EVT_BLOCKED:\n");
			break;
		case NRF_MODEM_GNSS_EVT_UNBLOCKED:
			printk("NRF_MODEM_GNSS_EVT_UNBLOCKED:\n");
			break;
		case NRF_MODEM_GNSS_EVT_PERIODIC_WAKEUP:
			printk("NRF_MODEM_GNSS_EVT_PERIODIC_WAKEUP:\n");
			break;
		case NRF_MODEM_GNSS_EVT_SLEEP_AFTER_TIMEOUT:
			printk("NRF_MODEM_GNSS_EVT_SLEEP_AFTER_TIMEOUT:\n");
			break;
		case NRF_MODEM_GNSS_EVT_SLEEP_AFTER_FIX:
			printk("NRF_MODEM_GNSS_EVT_SLEEP_AFTER_FIX:\n");
			break;
		case NRF_MODEM_GNSS_EVT_REF_ALT_EXPIRED:
			printk("NRF_MODEM_GNSS_EVT_REF_ALT_EXPIRED:\n");
			break;

		default:
			printk("Unknown GNSS Event %d\n",event);
			break;
	}
}

int gnss_config(int gps_fix_retry_interval){

	int err;

	if ((err = lte_lc_func_mode_set(LTE_LC_FUNC_MODE_ACTIVATE_GNSS))) {
		printk("Failed enabling GNSS Functional Mode, error: %d\n", err);
	}

	// Set to 0 for single fix mode. GNSS will switch off after valid
	// fix or when fix_retry_set has been reached.
	// Set to 1 for continuous navigation. GNSS receiver to produce
	// PVT @ 1Hz
	err = nrf_modem_gnss_fix_interval_set(0);
	// Number of times to try for a fix
	// nrf_modem_gnss_fix_retry_set(GNSS_FIX_RETRY_SEC);
	// For now set to maximum value which is the gps interval, shall be finalized later
	err = nrf_modem_gnss_fix_retry_set(gps_fix_retry_interval - 10);

	// By default, all NMEA strings are disabled.
#ifdef NMEA
	/* Enable all supported NMEA messages. */
	uint16_t nmea_mask = 	NRF_MODEM_GNSS_NMEA_RMC_MASK |
							NRF_MODEM_GNSS_NMEA_GGA_MASK |
							NRF_MODEM_GNSS_NMEA_GLL_MASK |
							NRF_MODEM_GNSS_NMEA_GSA_MASK |
							NRF_MODEM_GNSS_NMEA_GSV_MASK;

	if (nrf_modem_gnss_nmea_mask_set(nmea_mask) != 0) {
		printk("Failed to set GNSS NMEA mask\n");
	}
#endif

	// Enable low accuracy mode
	if ((err = nrf_modem_gnss_use_case_set(NRF_MODEM_GNSS_USE_CASE_MULTIPLE_HOT_START | NRF_MODEM_GNSS_USE_CASE_LOW_ACCURACY))) {
		printk("Failed to set low accuracy mode, error %d\n",err);
	}

	return err;
}

void gnss_init(){

	int err;

	if ((err = nrf_modem_gnss_event_handler_set(gnss_event_handler))) {
		printk("Failed to set GNSS event handler, error: %d\n", err);
	}

	err = gnss_config(gps_interval);
	if (err != 0) {
		printk("Error during GNSS configuration: %d\n", err);
	}

	k_work_schedule(&gnss_start_single_fix, K_SECONDS(gps_interval));

}
```

## src/gps.h
```c
#pragma once

extern struct k_sem pvt_data_sem;
extern struct nrf_modem_gnss_pvt_data_frame pvt_data;
void gnss_event_handler(int event);
void gnss_init();
int gnss_config(int gps_fix_retry_interval);
```

## src/lte.h
```c
#pragma once

extern struct k_sem lte_connected;
extern bool psm_activated;

void lte_handler(const struct lte_lc_evt *const evt);
void modem_configure(void);
```

## src/main.h
```c
#pragma once

extern struct k_work_delayable shadow_update_work;
extern struct k_work_delayable connect_work;
extern struct k_work shadow_update_version_work;
extern struct k_work_delayable gnss_start_single_fix;
extern struct k_work_delayable gnss_work;

extern bool cloud_connected;
extern bool gps_fix_valid;
extern int gps_interval;
extern int aws_interval;
extern double last_reported_latitude;
extern double last_reported_longitude;
extern float last_reported_voltage, last_reported_temperature, last_reported_humidity;

void connect_work_fn(struct k_work *work);
void shadow_update_work_fn(struct k_work *work);
void shadow_update_version_work_fn(struct k_work *work);
void gnss_start_single_fix_fn(struct k_work *work);
void gnss_work_fn();
```
